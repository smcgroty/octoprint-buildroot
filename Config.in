## package/Config.in
```kconfig
menu "OctoPrint"
	source "$BR2_EXTERNAL_OCTOPRINT_PATH/package/python-octoprint/Config.in"
endmenu
```

## package/python-octoprint/Config.in
```kconfig
config BR2_PACKAGE_OCTOPRINT
	bool "octoprint"
        depends on BR2_PACKAGE_PYTHON
	help
		OctoPrint provides a snappy web interface for controlling consumer 3D printers. 

		http://octoprint.org/
```
